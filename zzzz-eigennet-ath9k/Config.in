## zzzz-eigennet-ath9k/Config.in
```kconfig
config EIGENNET_ATHEROS_LITE
	prompt "This packet configure atheros hardware for EigenNet"
	tristate
	default m if CONFIG_DEVEL
	help
		For more info http://eigenlab.tk
```

## zzzz-eigennet-autoconf/Config.in
```kconfig
config EIGENNET_AUTOCONF
	prompt "This packet configure hardware for EigenNet"
	tristate
	default m if CONFIG_DEVEL
	help
		For more info http://eigenlab.org
```

## zzzz-eigennet-ipkg-fon-fonera-scrokker/Config.in
```kconfig
config EIGENNET_ATHEROS_FON_FONERA_SCROKKER
	prompt "Questo pacchetto prepara la fonerqa per lo scrokking"
	tristate
	default m if CONFIG_DEVEL
	help
		Per la documentazione visita eigenlab.tk
```

## zzzz-eigennet-ipkg-fon-fonera/Config.in
```kconfig
config EIGENNET_ATHEROS_FON_FONERA
	prompt "Questo pacchetto prepara la Fon Fonera per il funzionamento con Eigennet"
	tristate
	default m if CONFIG_DEVEL
	help
		Per la documentazione visita eigenlab.tk
```

## zzzz-eigennet-ipkg-scrokker-fon-fonera/Config.in
```kconfig
config EIGENNET_ATHEROS_FON_FONERA_SCROKKER
	prompt "This package prepare fonera for scrokking"
	tristate
	default m if CONFIG_DEVEL
	help
		For more info see eigenlab.tk
```

## zzzz-eigennet-node-ipkg-atheros/Config.in
```kconfig
config EIGENNET_ATHEROS_UBIQUITI_BULLET2
	prompt "This packet configure atheros hardware for EigenNet"
	tristate
	default m if CONFIG_DEVEL
	help
		For more info http://eigenlab.tk
```
